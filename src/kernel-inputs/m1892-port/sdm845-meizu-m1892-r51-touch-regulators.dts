// SPDX-License-Identifier: GPL-2.0-only
/*
 * M1892 R51 touch regulator-provider isolation stage.
 *
 * Stock assigns Synaptics bus/IO power to PM8998 L14 and analog power to
 * PM8998 L28.  Declare those two RPMh regulators with the exact stock voltage
 * ranges, but intentionally provide no consumer, boot-on or always-on flag.
 * This must only prove provider registration; it must not power, reset,
 * interrupt or enumerate the touch controller.
 */

#include "sdm845-meizu-m1892-r48-i2c5-gpi.dts"

&apps_rsc {
	regulators-0 {
		vdd-l16-l28-supply = <&vreg_bob>;

		touch_vdd_1p8: ldo14 {
			regulator-min-microvolt = <1800000>;
			regulator-max-microvolt = <1880000>;
			regulator-initial-mode = <RPMH_REGULATOR_MODE_HPM>;
		};

		touch_avdd_2p856: ldo28 {
			regulator-min-microvolt = <2856000>;
			regulator-max-microvolt = <3008000>;
			regulator-initial-mode = <RPMH_REGULATOR_MODE_HPM>;
		};
	};
};
