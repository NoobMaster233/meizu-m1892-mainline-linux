/dts-v1/;
/plugin/;

/*
 * Narrow daily candidate: expose the PM8998 RESIN input as volume-down.
 * KEY_VOLUMEDOWN is Linux input code 114 (0x72), matching the stock merged DT.
 */

 / {
	fragment@0 {
		target-path = "/soc@0/spmi@c440000/pmic@0/pon@800/resin";

		__overlay__ {
			linux,code = <114>;
			status = "okay";
		};
	};
};
